/******************************************************************************\
*  Copyright (C) 2012 Nan Li, Tianjin University 
*  ALL RIGHTS RESERVED
*  Filename: OLED.c
*  Version: 1.1 添加黑底白字反转功能
*  Author: Nan Li
\******************************************************************************/


#include  "common.h"
#include "OLED.h"
#include  "gpio.h"
#include  "delay.h"     //延时
//#include <stdio.h>


//======================================
const unsigned char F6x8[][6] =
{
    { 0x00, 0x00, 0x00, 0x00, 0x00, 0x00 },   // sp
    { 0x00, 0x00, 0x00, 0x2f, 0x00, 0x00 },   // !
    { 0x00, 0x00, 0x07, 0x00, 0x07, 0x00 },   // "
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    { 0x14, 0x14, 0x14, 0x14, 0x14, 0x14 }    // horiz lines
};

//======================================
const unsigned char F6x8_Converse[][6] =
{
    { 0xFF-0x00, 0xFF-0x00, 0xFF-0x00, 0xFF-0x00, 0xFF-0x00, 0xFF-0x00 },   // sp
    { 0xFF-0x00, 0xFF-0x00, 0xFF-0x00, 0xFF-0x2f, 0xFF-0x00, 0xFF-0x00 },   // !
    { 0xFF-0x00, 0xFF-0x00, 0xFF-0x07, 0xFF-0x00, 0xFF-0x07, 0xFF-0x00 },   // "
    { 0xFF-0x00, 0xFF-0x14, 0xFF-0x7f, 0xFF-0x14, 0xFF-0x7f, 0xFF-0x14 },   // #
    { 0xFF-0x00, 0xFF-0x24, 0xFF-0x2a, 0xFF-0x7f, 0xFF-0x2a, 0xFF-0x12 },   // $
    { 0xFF-0x00, 0xFF-0x62, 0xFF-0x64, 0xFF-0x08, 0xFF-0x13, 0xFF-0x23 },   // %
    { 0xFF-0x00, 0xFF-0x36, 0xFF-0x49, 0xFF-0x55, 0xFF-0x22, 0xFF-0x50 },   // &
    { 0xFF-0x00, 0xFF-0x00, 0xFF-0x05, 0xFF-0x03, 0xFF-0x00, 0xFF-0x00 },   // '
    { 0xFF-0x00, 0xFF-0x00, 0xFF-0x1c, 0xFF-0x22, 0xFF-0x41, 0xFF-0x00 },   // (
    { 0xFF-0x00, 0xFF-0x00, 0xFF-0x41, 0xFF-0x22, 0xFF-0x1c, 0xFF-0x00 },   // )
    { 0xFF-0x00, 0xFF-0x14, 0xFF-0x08, 0xFF-0x3E, 0xFF-0x08, 0xFF-0x14 },   // *
    { 0xFF-0x00, 0xFF-0x08, 0xFF-0x08, 0xFF-0x3E, 0xFF-0x08, 0xFF-0x08 },   // +
    { 0xFF-0x00, 0xFF-0x00, 0xFF-0x00, 0xFF-0xA0, 0xFF-0x60, 0xFF-0x00 },   // ,
    { 0xFF-0x00, 0xFF-0x08, 0xFF-0x08, 0xFF-0x08, 0xFF-0x08, 0xFF-0x08 },   // -
    { 0xFF-0x00, 0xFF-0x00, 0xFF-0x60, 0xFF-0x60, 0xFF-0x00, 0xFF-0x00 },   // .
    { 0xFF-0x00, 0xFF-0x20, 0xFF-0x10, 0xFF-0x08, 0xFF-0x04, 0xFF-0x02 },   // /
    { 0xFF-0x00, 0xFF-0x3E, 0xFF-0x51, 0xFF-0x49, 0xFF-0x45, 0xFF-0x3E },   // 0
    { 0xFF-0x00, 0xFF-0x00, 0xFF-0x42, 0xFF-0x7F, 0xFF-0x40, 0xFF-0x00 },   // 1
    { 0xFF-0x00, 0xFF-0x42, 0xFF-0x61, 0xFF-0x51, 0xFF-0x49, 0xFF-0x46 },   // 2
    { 0xFF-0x00, 0xFF-0x21, 0xFF-0x41, 0xFF-0x45, 0xFF-0x4B, 0xFF-0x31 },   // 3
    { 0xFF-0x00, 0xFF-0x18, 0xFF-0x14, 0xFF-0x12, 0xFF-0x7F, 0xFF-0x10 },   // 4
    { 0xFF-0x00, 0xFF-0x27, 0xFF-0x45, 0xFF-0x45, 0xFF-0x45, 0xFF-0x39 },   // 5
    { 0xFF-0x00, 0xFF-0x3C, 0xFF-0x4A, 0xFF-0x49, 0xFF-0x49, 0xFF-0x30 },   // 6
    { 0xFF-0x00, 0xFF-0x01, 0xFF-0x71, 0xFF-0x09, 0xFF-0x05, 0xFF-0x03 },   // 7
    { 0xFF-0x00, 0xFF-0x36, 0xFF-0x49, 0xFF-0x49, 0xFF-0x49, 0xFF-0x36 },   // 8
    { 0xFF-0x00, 0xFF-0x06, 0xFF-0x49, 0xFF-0x49, 0xFF-0x29, 0xFF-0x1E },   // 9
    { 0xFF-0x00, 0xFF-0x00, 0xFF-0x36, 0xFF-0x36, 0xFF-0x00, 0xFF-0x00 },   // :
    { 0xFF-0x00, 0xFF-0x00, 0xFF-0x56, 0xFF-0x36, 0xFF-0x00, 0xFF-0x00 },   // ;
    { 0xFF-0x00, 0xFF-0x08, 0xFF-0x14, 0xFF-0x22, 0xFF-0x41, 0xFF-0x00 },   // <
    { 0xFF-0x00, 0xFF-0x14, 0xFF-0x14, 0xFF-0x14, 0xFF-0x14, 0xFF-0x14 },   // =
    { 0xFF-0x00, 0xFF-0x00, 0xFF-0x41, 0xFF-0x22, 0xFF-0x14, 0xFF-0x08 },   // >
    { 0xFF-0x00, 0xFF-0x02, 0xFF-0x01, 0xFF-0x51, 0xFF-0x09, 0xFF-0x06 },   // ?
    { 0xFF-0x00, 0xFF-0x32, 0xFF-0x49, 0xFF-0x59, 0xFF-0x51, 0xFF-0x3E },   // @
    { 0xFF-0x00, 0xFF-0x7C, 0xFF-0x12, 0xFF-0x11, 0xFF-0x12, 0xFF-0x7C },   // A
    { 0xFF-0x00, 0xFF-0x7F, 0xFF-0x49, 0xFF-0x49, 0xFF-0x49, 0xFF-0x36 },   // B
    { 0xFF-0x00, 0xFF-0x3E, 0xFF-0x41, 0xFF-0x41, 0xFF-0x41, 0xFF-0x22 },   // C
    { 0xFF-0x00, 0xFF-0x7F, 0xFF-0x41, 0xFF-0x41, 0xFF-0x22, 0xFF-0x1C },   // D
    { 0xFF-0x00, 0xFF-0x7F, 0xFF-0x49, 0xFF-0x49, 0xFF-0x49, 0xFF-0x41 },   // E
    { 0xFF-0x00, 0xFF-0x7F, 0xFF-0x09, 0xFF-0x09, 0xFF-0x09, 0xFF-0x01 },   // F
    { 0xFF-0x00, 0xFF-0x3E, 0xFF-0x41, 0xFF-0x49, 0xFF-0x49, 0xFF-0x7A },   // G
    { 0xFF-0x00, 0xFF-0x7F, 0xFF-0x08, 0xFF-0x08, 0xFF-0x08, 0xFF-0x7F },   // H
    { 0xFF-0x00, 0xFF-0x00, 0xFF-0x41, 0xFF-0x7F, 0xFF-0x41, 0xFF-0x00 },   // I
    { 0xFF-0x00, 0xFF-0x20, 0xFF-0x40, 0xFF-0x41, 0xFF-0x3F, 0xFF-0x01 },   // J
    { 0xFF-0x00, 0xFF-0x7F, 0xFF-0x08, 0xFF-0x14, 0xFF-0x22, 0xFF-0x41 },   // K
    { 0xFF-0x00, 0xFF-0x7F, 0xFF-0x40, 0xFF-0x40, 0xFF-0x40, 0xFF-0x40 },   // L
    { 0xFF-0x00, 0xFF-0x7F, 0xFF-0x02, 0xFF-0x0C, 0xFF-0x02, 0xFF-0x7F },   // M
    { 0xFF-0x00, 0xFF-0x7F, 0xFF-0x04, 0xFF-0x08, 0xFF-0x10, 0xFF-0x7F },   // N
    { 0xFF-0x00, 0xFF-0x3E, 0xFF-0x41, 0xFF-0x41, 0xFF-0x41, 0xFF-0x3E },   // O
    { 0xFF-0x00, 0xFF-0x7F, 0xFF-0x09, 0xFF-0x09, 0xFF-0x09, 0xFF-0x06 },   // P
    { 0xFF-0x00, 0xFF-0x3E, 0xFF-0x41, 0xFF-0x51, 0xFF-0x21, 0xFF-0x5E },   // Q
    { 0xFF-0x00, 0xFF-0x7F, 0xFF-0x09, 0xFF-0x19, 0xFF-0x29, 0xFF-0x46 },   // R
    { 0xFF-0x00, 0xFF-0x46, 0xFF-0x49, 0xFF-0x49, 0xFF-0x49, 0xFF-0x31 },   // S
    { 0xFF-0x00, 0xFF-0x01, 0xFF-0x01, 0xFF-0x7F, 0xFF-0x01, 0xFF-0x01 },   // T
    { 0xFF-0x00, 0xFF-0x3F, 0xFF-0x40, 0xFF-0x40, 0xFF-0x40, 0xFF-0x3F },   // U
    { 0xFF-0x00, 0xFF-0x1F, 0xFF-0x20, 0xFF-0x40, 0xFF-0x20, 0xFF-0x1F },   // V
    { 0xFF-0x00, 0xFF-0x3F, 0xFF-0x40, 0xFF-0x38, 0xFF-0x40, 0xFF-0x3F },   // W
    { 0xFF-0x00, 0xFF-0x63, 0xFF-0x14, 0xFF-0x08, 0xFF-0x14, 0xFF-0x63 },   // X
    { 0xFF-0x00, 0xFF-0x07, 0xFF-0x08, 0xFF-0x70, 0xFF-0x08, 0xFF-0x07 },   // Y
    { 0xFF-0x00, 0xFF-0x61, 0xFF-0x51, 0xFF-0x49, 0xFF-0x45, 0xFF-0x43 },   // Z
    { 0xFF-0x00, 0xFF-0x00, 0xFF-0x7F, 0xFF-0x41, 0xFF-0x41, 0xFF-0x00 },   // [
    { 0xFF-0x00, 0xFF-0x55, 0xFF-0x2A, 0xFF-0x55, 0xFF-0x2A, 0xFF-0x55 },   // 55
    { 0xFF-0x00, 0xFF-0x00, 0xFF-0x41, 0xFF-0x41, 0xFF-0x7F, 0xFF-0x00 },   // ]
    { 0xFF-0x00, 0xFF-0x04, 0xFF-0x02, 0xFF-0x01, 0xFF-0x02, 0xFF-0x04 },   // ^
    { 0xFF-0x00, 0xFF-0x40, 0xFF-0x40, 0xFF-0x40, 0xFF-0x40, 0xFF-0x40 },   // _
    { 0xFF-0x00, 0xFF-0x00, 0xFF-0x01, 0xFF-0x02, 0xFF-0x04, 0xFF-0x00 },   // '
    { 0xFF-0x00, 0xFF-0x20, 0xFF-0x54, 0xFF-0x54, 0xFF-0x54, 0xFF-0x78 },   // a
    { 0xFF-0x00, 0xFF-0x7F, 0xFF-0x48, 0xFF-0x44, 0xFF-0x44, 0xFF-0x38 },   // b
    { 0xFF-0x00, 0xFF-0x38, 0xFF-0x44, 0xFF-0x44, 0xFF-0x44, 0xFF-0x20 },   // c
    { 0xFF-0x00, 0xFF-0x38, 0xFF-0x44, 0xFF-0x44, 0xFF-0x48, 0xFF-0x7F },   // d
    { 0xFF-0x00, 0xFF-0x38, 0xFF-0x54, 0xFF-0x54, 0xFF-0x54, 0xFF-0x18 },   // e
    { 0xFF-0x00, 0xFF-0x08, 0xFF-0x7E, 0xFF-0x09, 0xFF-0x01, 0xFF-0x02 },   // f
    { 0xFF-0x00, 0xFF-0x18, 0xFF-0xA4, 0xFF-0xA4, 0xFF-0xA4, 0xFF-0x7C },   // g
    { 0xFF-0x00, 0xFF-0x7F, 0xFF-0x08, 0xFF-0x04, 0xFF-0x04, 0xFF-0x78 },   // h
    { 0xFF-0x00, 0xFF-0x00, 0xFF-0x44, 0xFF-0x7D, 0xFF-0x40, 0xFF-0x00 },   // i
    { 0xFF-0x00, 0xFF-0x40, 0xFF-0x80, 0xFF-0x84, 0xFF-0x7D, 0xFF-0x00 },   // j
    { 0xFF-0x00, 0xFF-0x7F, 0xFF-0x10, 0xFF-0x28, 0xFF-0x44, 0xFF-0x00 },   // k
    { 0xFF-0x00, 0xFF-0x00, 0xFF-0x41, 0xFF-0x7F, 0xFF-0x40, 0xFF-0x00 },   // l
    { 0xFF-0x00, 0xFF-0x7C, 0xFF-0x04, 0xFF-0x18, 0xFF-0x04, 0xFF-0x78 },   // m
    { 0xFF-0x00, 0xFF-0x7C, 0xFF-0x08, 0xFF-0x04, 0xFF-0x04, 0xFF-0x78 },   // n
    { 0xFF-0x00, 0xFF-0x38, 0xFF-0x44, 0xFF-0x44, 0xFF-0x44, 0xFF-0x38 },   // o
    { 0xFF-0x00, 0xFF-0xFC, 0xFF-0x24, 0xFF-0x24, 0xFF-0x24, 0xFF-0x18 },   // p
    { 0xFF-0x00, 0xFF-0x18, 0xFF-0x24, 0xFF-0x24, 0xFF-0x18, 0xFF-0xFC },   // q
    { 0xFF-0x00, 0xFF-0x7C, 0xFF-0x08, 0xFF-0x04, 0xFF-0x04, 0xFF-0x08 },   // r
    { 0xFF-0x00, 0xFF-0x48, 0xFF-0x54, 0xFF-0x54, 0xFF-0x54, 0xFF-0x20 },   // s
    { 0xFF-0x00, 0xFF-0x04, 0xFF-0x3F, 0xFF-0x44, 0xFF-0x40, 0xFF-0x20 },   // t
    { 0xFF-0x00, 0xFF-0x3C, 0xFF-0x40, 0xFF-0x40, 0xFF-0x20, 0xFF-0x7C },   // u
    { 0xFF-0x00, 0xFF-0x1C, 0xFF-0x20, 0xFF-0x40, 0xFF-0x20, 0xFF-0x1C },   // v
    { 0xFF-0x00, 0xFF-0x3C, 0xFF-0x40, 0xFF-0x30, 0xFF-0x40, 0xFF-0x3C },   // w
    { 0xFF-0x00, 0xFF-0x44, 0xFF-0x28, 0xFF-0x10, 0xFF-0x28, 0xFF-0x44 },   // x
    { 0xFF-0x00, 0xFF-0x1C, 0xFF-0xA0, 0xFF-0xA0, 0xFF-0xA0, 0xFF-0x7C },   // y
    { 0xFF-0x00, 0xFF-0x44, 0xFF-0x64, 0xFF-0x54, 0xFF-0x4C, 0xFF-0x44 },   // z
    { 0xFF-0x14, 0xFF-0x14, 0xFF-0x14, 0xFF-0x14, 0xFF-0x14, 0xFF-0x14 }    // horiz lines
};

const unsigned char F14x16_Idx[] = 
{
    "天津大学智能车队"
};
const unsigned char F14x16[] = { // Verdana11 
0x40,0x42,0x42,0x42,0x42,0x42,0xFE,0x42,0x42,0x42,0x42,0x42,0x40,0x00,
0x20,0x20,0x10,0x08,0x04,0x03,0x00,0x03,0x04,0x08,0x10,0x20,0x20,0x00,//天0
0x20,0x42,0x04,0x80,0x10,0x54,0x54,0x54,0xFF,0x54,0x54,0x7C,0x10,0x00,
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0x00,0x3F,0x04,0x04,0x23,0x10,0x0C,0x03,0x00,0x03,0x0C,0x10,0x20,0x00,//队7
};

 
void OLED_WrDat(unsigned char data)
{
	unsigned char i=8;
	//CS=0;;
	DC=1;
  D0=0;
  //asm("nop");    
  while(i--)
  {
    if(data&0x80){D1=1;}
    else{D1=0;}
    D0=1; 
    //asm("nop");
		//asm("nop");            
    D0=0;    
    data<<=1;    
  }
	//CS=1;
}

void OLED_WrCmd(unsigned char cmd)
{
	unsigned char i=8;
	
	//CS=0;;
	DC=0;
  D0=0;
  //asm("nop");   
  while(i--)
  {
    if(cmd&0x80){D1=1;}
    else{D1=0;}
    D0=1;
    //asm("nop");
		//asm("nop");             
    D0=0;    
    cmd<<=1;   
  } 	
	//CS=1;
}

void OLED_Set_Pos(unsigned char x, unsigned char y)
{ 
  OLED_WrCmd(0xb0+y);
  OLED_WrCmd(((x&0xf0)>>4)|0x10);
  OLED_WrCmd((x&0x0f)|0x01); 
} 

void OLED_Fill(unsigned char bmp_data)
{
	unsigned char y,x;
	
	for(y=0;y<8;y++)
	{
		OLED_WrCmd(0xb0+y);
		OLED_WrCmd(0x01);
		OLED_WrCmd(0x10);
		for(x=0;x<X_WIDTH;x++)
			OLED_WrDat(bmp_data);
	}
}

void OLED_CLS(void)
{
	unsigned char y,x;	
	for(y=0;y<8;y++)
	{
		OLED_WrCmd(0xb0+y);
		OLED_WrCmd(0x01);
		OLED_WrCmd(0x10); 
		for(x=0;x<X_WIDTH;x++)
			OLED_WrDat(0);
	}
}


void adjust(unsigned char a)
{
  OLED_WrCmd(a);	//指令数据0x0000~0x003f  
}

void SetStartColumn(unsigned char d)
{
	OLED_WrCmd(0x00+d%16);		// Set Lower Column Start Address for Page Addressing Mode
						//   Default => 0x00
	OLED_WrCmd(0x10+d/16);		// Set Higher Column Start Address for Page Addressing Mode
						//   Default => 0x10
}

void SetAddressingMode(unsigned char d)
{
	OLED_WrCmd(0x20);			// Set Memory Addressing Mode
	OLED_WrCmd(d);			//   Default => 0x02
						//     0x00 => Horizontal Addressing Mode
						//     0x01 => Vertical Addressing Mode
						//     0x02 => Page Addressing Mode
}

void SetColumnAddress(unsigned char a, unsigned char b)
{
	OLED_WrCmd(0x21);			// Set Column Address
	OLED_WrCmd(a);			//   Default => 0x00 (Column Start Address)
	OLED_WrCmd(b);			//   Default => 0x7F (Column End Address)
}

void SetPageAddress(unsigned char a, unsigned char b)
{
	OLED_WrCmd(0x22);			// Set Page Address
	OLED_WrCmd(a);			//   Default => 0x00 (Page Start Address)
	OLED_WrCmd(b);			//   Default => 0x07 (Page End Address)
}

void SetStartLine(unsigned char d)
{
	OLED_WrCmd(0x40|d);			// Set Display Start Line
						//   Default => 0x40 (0x00)
}

void SetContrastControl(unsigned char d)
{
	OLED_WrCmd(0x81);			// Set Contrast Control
	OLED_WrCmd(d);			//   Default => 0x7F
}

void Set_Charge_Pump(unsigned char d)
{
	OLED_WrCmd(0x8D);			// Set Charge Pump
	OLED_WrCmd(0x10|d);			//   Default => 0x10
						//     0x10 (0x00) => Disable Charge Pump
						//     0x14 (0x04) => Enable Charge Pump
}

void Set_Segment_Remap(unsigned char d)
{
	OLED_WrCmd(0xA0|d);			// Set Segment Re-Map
						//   Default => 0xA0
						//     0xA0 (0x00) => Column Address 0 Mapped to SEG0
						//     0xA1 (0x01) => Column Address 0 Mapped to SEG127
}

void Set_Entire_Display(unsigned char d)
{
	OLED_WrCmd(0xA4|d);			// Set Entire Display On / Off
						//   Default => 0xA4
						//     0xA4 (0x00) => Normal Display
						//     0xA5 (0x01) => Entire Display On
}

void Set_Inverse_Display(unsigned char d)
{
	OLED_WrCmd(0xA6|d);			// Set Inverse Display On/Off
						//   Default => 0xA6
						//     0xA6 (0x00) => Normal Display
						//     0xA7 (0x01) => Inverse Display On
}

void Set_Multiplex_Ratio(unsigned char d)
{
	OLED_WrCmd(0xA8);			// Set Multiplex Ratio
	OLED_WrCmd(d);			//   Default => 0x3F (1/64 Duty)
}

void Set_Display_On_Off(unsigned char d)
{
	OLED_WrCmd(0xAE|d);			// Set Display On/Off
						//   Default => 0xAE
						//     0xAE (0x00) => Display Off
						//     0xAF (0x01) => Display On
}

void SetStartPage(unsigned char d)
{
	OLED_WrCmd(0xB0|d);			// Set Page Start Address for Page Addressing Mode
						//   Default => 0xB0 (0x00)
}

void Set_Common_Remap(unsigned char d)
{
	OLED_WrCmd(0xC0|d);			// Set COM Output Scan Direction
						//   Default => 0xC0
						//     0xC0 (0x00) => Scan from COM0 to 63
						//     0xC8 (0x08) => Scan from COM63 to 0
}

void Set_Display_Offset(unsigned char d)
{
	OLED_WrCmd(0xD3);			// Set Display Offset
	OLED_WrCmd(d);			//   Default => 0x00
}

void Set_Display_Clock(unsigned char d)
{
	OLED_WrCmd(0xD5);			// Set Display Clock Divide Ratio / Oscillator Frequency
	OLED_WrCmd(d);			//   Default => 0x80
						//     D[3:0] => Display Clock Divider
						//     D[7:4] => Oscillator Frequency
}

void Set_Precharge_Period(unsigned char d)
{
	OLED_WrCmd(0xD9);			// Set Pre-Charge Period
	OLED_WrCmd(d);			//   Default => 0x22 (2 Display Clocks [Phase 2] / 2 Display Clocks [Phase 1])
						//     D[3:0] => Phase 1 Period in 1~15 Display Clocks
						//     D[7:4] => Phase 2 Period in 1~15 Display Clocks
}

void Set_Common_Config(unsigned char d)
{
	OLED_WrCmd(0xDA);			// Set COM Pins Hardware Configuration
	OLED_WrCmd(0x02|d);			//   Default => 0x12 (0x10)
						//     Alternative COM Pin Configuration
						//     Disable COM Left/Right Re-Map
}

void Set_VCOMH(unsigned char d)
{
	OLED_WrCmd(0xDB);			// Set VCOMH Deselect Level
	OLED_WrCmd(d);			//   Default => 0x20 (0.77*VCC)
}

void Set_NOP(void)
{
	OLED_WrCmd(0xE3);			// Command for No Operation
}

void OLED_Init(void)        
{
  //OLED Pins
  gpio_init (PORTA,12,GPO,1); 
  gpio_init (PORTA,13,GPO,1);
  gpio_init (PORTA,15,GPO,1); 
  gpio_init (PORTA,16,GPO,1);
  
  D0=1;
  //CS=1;	//预制SLK和SS为高电平   	
  
  RST=0;
  DLY_ms(50);
  RST=1;
	
	//从上电到下面开始初始化要有足够的时间，即等待RC复位完毕
  Set_Display_On_Off(0x00);		  // Display Off (0x00/0x01)
  Set_Display_Clock(0x80);		  // Set Clock as 100 Frames/Sec
  Set_Multiplex_Ratio(0x3F);		// 1/64 Duty (0x0F~0x3F)
  Set_Display_Offset(0x00);		  // Shift Mapping RAM Counter (0x00~0x3F)
  SetStartLine(0x00);			      // Set Mapping RAM Display Start Line (0x00~0x3F)
  Set_Charge_Pump(0x04);		    // Enable Embedded DC/DC Converter (0x00/0x04)
  SetAddressingMode(0x02);		  // Set Page Addressing Mode (0x00/0x01/0x02)
  Set_Segment_Remap(0x01);		  // Set SEG/Column Mapping     0x00左右反置 0x01正常
  Set_Common_Remap(0x08);			  // Set COM/Row Scan Direction 0x00上下反置 0x08正常
  Set_Common_Config(0x10);		  // Set Sequential Configuration (0x00/0x10)
  SetContrastControl(Brightness);	// Set SEG Output Current
  Set_Precharge_Period(0xF1);		// Set Pre-Charge as 15 Clocks & Discharge as 1 Clock
  Set_VCOMH(0x40);			        // Set VCOM Deselect Level
  Set_Entire_Display(0x00);		  // Disable Entire Display On (0x00/0x01)
  Set_Inverse_Display(0x00);		// Disable Inverse Display On (0x00/0x01)  
  Set_Display_On_Off(0x01);		  // Display On (0x00/0x01)
  OLED_Fill(0x00);  //初始清屏
	OLED_Set_Pos(0,0); 
} 


//==============================================================
//函数名：OLED_P6x8Str(unsigned char x,unsigned char y,unsigned char *p,unsigned char ConverseSelect)
//功能描述：写入一组标准ASCII字符串
//参数：显示的位置（x,y），y为页范围0～7，要显示的字符串, 黑底白字反转选择(0:黑底白字 1:白底黑字)
//返回：无
//==============================================================  
void OLED_P6x8Str(unsigned char x,unsigned char y,unsigned char ch[],unsigned char ConverseSelect)
{
  unsigned char c=0,i=0,j=0;      
  while (ch[j]!='\0')
  {    
    c =ch[j]-32;
    if(x>122){x=0;y++;}
    OLED_Set_Pos(x,y);    
  	for(i=0;i<6;i++)     
  	{
  	  if(ConverseSelect) OLED_WrDat(F6x8_Converse[c][i]); 
  	  else OLED_WrDat(F6x8[c][i]);
  	}
  	x+=6;
  	j++;
  }
}

//输出汉字字符串
void OLED_P14x16Str(unsigned char x,unsigned char y,unsigned char ch[])
{
	unsigned char wm=0,ii = 0;
	unsigned int adder=1; 
	
	while(ch[ii] != '\0')
	{
  	wm = 0;
  	adder = 1;
  	while(F14x16_Idx[wm] > 127)
  	{
  		if(F14x16_Idx[wm] == ch[ii])
  		{
  			if(F14x16_Idx[wm + 1] == ch[ii + 1])
  			{
  				adder = wm * 14;
  				break;
  			}
  		}
  		wm += 2;			
  	}
  	if(x>118){x=0;y++;}
  	OLED_Set_Pos(x , y); 
  	if(adder != 1)// 显示汉字					
  	{
  		OLED_Set_Pos(x , y);
  		for(wm = 0;wm < 14;wm++)               
  		{
  			OLED_WrDat(F14x16[adder]);	
  			adder += 1;
  		}      
  		OLED_Set_Pos(x,y + 1); 
  		for(wm = 0;wm < 14;wm++)          
  		{
  			OLED_WrDat(F14x16[adder]);
  			adder += 1;
  		}   		
  	}
  	else			  //显示空白字符			
  	{
  		ii += 1;
      OLED_Set_Pos(x,y);
  		for(wm = 0;wm < 16;wm++)
  		{
  				OLED_WrDat(0);
  		}
  		OLED_Set_Pos(x,y + 1);
  		for(wm = 0;wm < 16;wm++)
  		{   		
  				OLED_WrDat(0);	
  		}
  	}
  	x += 14;
  	ii += 2;
	}
}
//输出汉字和字符混合字符串
void OLED_Print(unsigned char x, unsigned char y, unsigned char ch[])
{
	unsigned char ch2[3];
	unsigned char ii=0;        
	while(ch[ii] != '\0')
	{
		if(ch[ii] > 127)
		{
			ch2[0] = ch[ii];
	 		ch2[1] = ch[ii + 1];
			ch2[2] = '\0';			//汉字为两个字节
			OLED_P14x16Str(x , y, ch2);	//显示汉字
			x += 14;
			ii += 2;
		}
		else
		{
			ch2[0] = ch[ii];	
			ch2[1] = '\0';			//字母占一个字节
			OLED_P6x8Str(x , y , ch2 , 0);	//显示字母
			x += 8;
			ii+= 1;
		}
	}
} 


void OLED_clear(void)
{
  unsigned char y,x;
  for(y=3;y<8;y++)
	{
		OLED_WrCmd(0xb0+y);
		OLED_WrCmd(0x01);
		OLED_WrCmd(0x10);
		for(x=0;x<X_WIDTH;x++)
			OLED_WrDat(0x00);
	}
}

void OLED_clear_all(void)
{
  unsigned char y,x;
  for(y=0;y<8;y++)
	{
		OLED_WrCmd(0xb0+y);
		OLED_WrCmd(0x01);
		OLED_WrCmd(0x10);
		for(x=0;x<X_WIDTH;x++)
			OLED_WrDat(0x00);
	}
}

void OLED_draw_line(unsigned int data[])
{
  unsigned char y,x;
  for(y=0;y<4;y++)
	{
		OLED_WrCmd(0xb0+y);
		OLED_WrCmd(0x01);
		OLED_WrCmd(0x10);
		for(x=0;x<X_WIDTH;x++)
			OLED_WrDat(data[x]);
	}
}

void OLED_clear_line(unsigned int line)
{
  unsigned char x;
  OLED_WrCmd(0xb0+line);
  OLED_WrCmd(0x01);
	OLED_WrCmd(0x10);
  for(x=0;x<X_WIDTH;x++)
			OLED_WrDat(0x00);
}

void OLED_clear_left(void)
{
  unsigned char y,x;
  for(y=0;y<8;y++)
  {
    for(x=0;x<55;x+=6) 
    {
      OLED_P6x8Str(x,y," ",0);
    }
  }
}

void OLED_clear_right(void)
{
  unsigned char y,x;
  for(y=0;y<8;y++)
  {
    for(x=64;x<121;x+=6) 
    {
      OLED_P6x8Str(x,y," ",0);
    }
  }
}

void OLED_Draw_Curve(unsigned char *data)
{
  unsigned char i,temp1,y1,temp2,y2;
  
  for(i=0;i<128;i+=2)   
  {
    y1=7-(data[i]>>3);   //获取行号
    y2=7-(data[i+1]>>3);
    temp1=1<<(7-(data[i]%8));
    temp2=1<<(7-(data[i+1]%8));
    if(y1==y2)
    {
      
      OLED_Set_Pos(i,y1);
      OLED_WrDat(temp1); 
      OLED_WrDat(temp2);
    }
    else
    {
      OLED_Set_Pos(i,y1);
      OLED_WrDat(temp1); 
      OLED_WrDat(0);
      OLED_Set_Pos(i,y2);
      OLED_WrDat(0); 
      OLED_WrDat(temp2);
    }
  }
}